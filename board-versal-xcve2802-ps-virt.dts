/*
 * Versal AI Edge series device xcve2802 virtual board dts
 *
 * Copyright (c) 2021, Xilinx Inc
 * All rights reserved.
 *
 * SPDX-License-Identifier: BSD-3-Clause
 */

/*
 * Unsupported Devices:
 *  CPM
 *  VDU
 *  PCIE
 */
#include "board-versal-xcvc2802-ps-virt.dts"

&pmc_tap {
	idcode = <0x14CD3093>;
};

/* Attach only one OSPI Flash */
&ospi {
	/delete-node/ ospi_flash_lcs_ub@0;
	/delete-node/ ospi_flash_ucs_lb@0;
	/delete-node/ ospi_flash_ucs_ub@0;
};

&ospi_flash_lcs_lb {
	compatible = "mt35xu02gbba";
};
