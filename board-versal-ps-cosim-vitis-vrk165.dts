/*
 * Vitis Versal VRK165 cosim board
 *
 * Copyright (c) 2026 Advanced Micro Devices, Inc.
 * All rights reserved.
 *
 * SPDX-License-Identifier: BSD-3-Clause
 */

#include "board-versal-ps-cosim-vrk165.dts"
#include "versal-vitis.dtsi"
