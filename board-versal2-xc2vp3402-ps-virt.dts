/*
 * Versal premium G2 series device xc2vp3402 virtual board dts
 *
 * Copyright (c) 2024-2025 Advanced Micro Devices, Inc. All rights reserved.
 *
 * SPDX-License-Identifier: BSD-3-Clause
 */

#include "board-versal2-xc2vp3602-ps-virt.dts"

&pmc_tap {
  idcode = <0x04C75093>;
};
