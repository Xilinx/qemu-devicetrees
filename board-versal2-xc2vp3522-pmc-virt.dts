/*
 * Versal Premium Gen 2 series device XC2VP3522 MOP virtual board dts
 *
 * Copyright (C) 2026 Advanced Micro Devices, Inc. All rights reserved.
 *
 * SPDX-License-Identifier: BSD-3-Clause
 */

#include "board-versal2-xc2vp3502-pmc-virt.dts"
