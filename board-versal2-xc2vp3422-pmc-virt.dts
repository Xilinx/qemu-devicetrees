/*
 * Versal Premium Gen 2 series device XC2VP3422 MOP virtual board dts
 *
 * Copyright Advanced Micro Devices, Inc.
 *
 * SPDX-License-Identifier: BSD-3-Clause
 */

#include "board-versal2-xc2vp3402-pmc-virt.dts"
