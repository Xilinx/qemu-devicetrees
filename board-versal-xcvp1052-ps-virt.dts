/*
 * Versal Premium series xcvp1052 virtual board dts
 *
 * Copyright (c) 2021, Xilinx Inc
 * All rights reserved.
 *
 * SPDX-License-Identifier: BSD-3-Clause
 */

/*
 * Unsupporeted FPGA hard blocks:
 *  CPM4
 *  PCIE
 *  HSC
 *  GTM
 *  GTYP
 *  100G, 400G, 600G Ethernet MAC's
 *
 * More details:
 * https://www.xilinx.com/products/silicon-devices/acap/versal-premium.html#productTable
 */

#define VERSAL_NPI_OVERRIDE
#include "versal/memmap/versal-xcvp1052-npi-memmap.dtsi"
#include "board-versal-ps-virt.dts"
#include "versal-silicon-freq.dtsi"

&pmc_tap {
	idcode = <0x04C18093>;
};

&amba_pmc_pl {
	bfr_0: bfr_0@MM_NPI_BFR_0 {
		compatible = "xlnx,noc-npi-dev";
		reg = <0x0 MM_NPI_BFR_0 0x0 MM_NPI_BFR_0_SIZE 0x1>;
		map-size = <MM_NPI_BFR_0_SIZE>;
		custom = <1>;
		pcsr-status = <0x18000D6>;
	};

	bfr_1: bfr_1@MM_NPI_BFR_1 {
		compatible = "xlnx,noc-npi-dev";
		reg = <0x0 MM_NPI_BFR_1 0x0 MM_NPI_BFR_1_SIZE 0x1>;
		map-size = <MM_NPI_BFR_1_SIZE>;
		custom = <1>;
		pcsr-status = <0x18000D6>;
	};
};
