/*
 * Versal Prime series device xqvm1502 virtual board dts
 *
 * Copyright (c) 2024, Advanced Micro Devices, Inc
 * All rights reserved.
 *
 * SPDX-License-Identifier: BSD-3-Clause
 */

#include "board-versal-xcvm1502-ps-virt.dts"
