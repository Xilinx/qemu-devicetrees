/*
 * Vitis Versal VRK160 cosim board
 *
 * Copyright Advanced Micro Devices, Inc.
 *
 * SPDX-License-Identifier: BSD-3-Clause
 */

#include "board-versal-ps-cosim-vrk160-revB.dts"
#include "versal-vitis.dtsi"
