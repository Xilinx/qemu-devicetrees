/*
 * Versal Premium series xcvp1202 virtual board dts
 *
 * Copyright (c) 2021, Xilinx Inc
 * All rights reserved.
 *
 * SPDX-License-Identifier: BSD-3-Clause
 */

/*
 * Unsupporeted FPGA hard blocks:
 *  CPM5
 *  PCIE
 *  HSC
 *  GTM
 *  GTYP
 *  100G, 400G, 600G Ethernet MAC's
 *
 * More details:
 * https://www.xilinx.com/products/silicon-devices/acap/versal-premium.html#productTable
 */

#define VERSAL_NPI_OVERRIDE
#define VERSAL_HAS_CPM5
#include "versal/memmap/xcvp1202.dtsh"
#include "versal/memmap/versal-xcvp1202-npi-memmap.dtsi"
#include "board-versal-ps-virt.dts"
#include "versal-silicon-freq.dtsi"

&pmc_tap {
	idcode = <0x14D00093>;
};
