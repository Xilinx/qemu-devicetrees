/*
 * Versal Virtual xcvh1582 board device tree
 *
 * Copyright (c) 2021, Xilinx Inc
 * All rights reserved.
 *
 * SPDX-License-Identifier: BSD-3-Clause
 */

/*
 * xcvh1582 is an SSIT devices.
 * We are emulating only Master SLR, no support for slave SLR's as SBI interface
 * needs ROM for initial PLM loading.
 */
#define VERSAL_NPI_OVERRIDE
#include "versal/memmap/versal-xcvh1582-npi-memmap.dtsi"
#include "board-versal-ps-virt.dts"
#include "versal-cpm5-memmap.dtsh"
#include "versal-cpm5.dtsi"
#include "versal-silicon-freq.dtsi"

&pmc_tap {
	idcode = <0x14D28093>;
};

&pmc_err_mng {
	ssit = <1>;
};
