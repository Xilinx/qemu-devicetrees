/*
 * Versal Premium Gen 2 series device XC2VP3622 MOP virtual board dts
 *
 * Copyright Advanced Micro Devices, Inc.
 *
 * SPDX-License-Identifier: BSD-3-Clause
 */

#include "board-versal2-xc2vp3602-pmc-virt.dts"
