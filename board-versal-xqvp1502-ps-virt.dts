/*
 * Versal Prime series device xqvp1502 virtual board dts
 *
 * Copyright (c) 2023 Advanced Micro Devices, Inc.
 * All rights reserved.
 *
 * SPDX-License-Identifier: BSD-3-Clause
 */

#include "board-versal-xcvp1502-ps-virt.dts"
