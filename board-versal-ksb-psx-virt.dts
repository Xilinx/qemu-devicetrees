/*
 * Versal Keystone-B Virtual PSX board device tree.
 *
 * Copyright (c) 2021, Xilinx Inc
 * All rights reserved.
 *
 * Redistribution and use in source and binary forms, with or without
 * modification, are permitted provided that the following conditions are met:
 *     * Redistributions of source code must retain the above copyright
 *       notice, this list of conditions and the following disclaimer.
 *     * Redistributions in binary form must reproduce the above copyright
 *       notice, this list of conditions and the following disclaimer in the
 *       documentation and/or other materials provided with the distribution.
 *     * Neither the name of the <organization> nor the
 *       names of its contributors may be used to endorse or promote products
 *       derived from this software without specific prior written permission.
 *
 * THIS SOFTWARE IS PROVIDED BY THE COPYRIGHT HOLDERS AND CONTRIBUTORS "AS IS" AND
 * ANY EXPRESS OR IMPLIED WARRANTIES, INCLUDING, BUT NOT LIMITED TO, THE IMPLIED
 * WARRANTIES OF MERCHANTABILITY AND FITNESS FOR A PARTICULAR PURPOSE ARE
 * DISCLAIMED. IN NO EVENT SHALL <COPYRIGHT HOLDER> BE LIABLE FOR ANY
 * DIRECT, INDIRECT, INCIDENTAL, SPECIAL, EXEMPLARY, OR CONSEQUENTIAL DAMAGES
 * (INCLUDING, BUT NOT LIMITED TO, PROCUREMENT OF SUBSTITUTE GOODS OR SERVICES;
 * LOSS OF USE, DATA, OR PROFITS; OR BUSINESS INTERRUPTION) HOWEVER CAUSED AND
 * ON ANY THEORY OF LIABILITY, WHETHER IN CONTRACT, STRICT LIABILITY, OR TORT
 * (INCLUDING NEGLIGENCE OR OTHERWISE) ARISING IN ANY WAY OUT OF THE USE OF THIS
 * SOFTWARE, EVEN IF ADVISED OF THE POSSIBILITY OF SUCH DAMAGE.
 */

#ifndef NUM_APUS
#define NUM_APUS 16
#endif

#define NUM_APUS_PER_CLUSTER 4

#define VERSAL_NPI_GENERIC
#define VERSAL_PSX
#define VERSAL_KSB

/* TODO: Add GIC interrupt redirection support.  */
#define APU_GIC_INTERRUPT_TARGET_STEM cpu
#define RPU_GIC_INTERRUPT_TARGET_STEM rpu_cpu

#define APU_CPU_MODEL "cortex-a78-arm-cpu"
#define RPU_CPU_MODEL "cortex-r52-arm-cpu"

#include "board-versal-ps-virt.dts"
#include "versal-psx.dtsi"
#include "ksb-psmx.dtsi"
#include "versal-psx-rpu.dtsi"
#include "versal-pmx-shared-overlay.dtsi"
#include "versal-pmx-system-overlay.dtsi"
#include "versal-psx-shared-overlay.dtsi"

#define SET_CPU_FREQ(n, f)					\
&cpu ## n {							\
	generic-timer-frequency = <f>;				\
}

SET_CPU_FREQ(0, 2720000);
SET_CPU_FREQ(1, 2720000);
SET_CPU_FREQ(2, 2720000);
SET_CPU_FREQ(3, 2720000);
SET_CPU_FREQ(4, 2720000);
SET_CPU_FREQ(5, 2720000);
SET_CPU_FREQ(6, 2720000);
SET_CPU_FREQ(7, 2720000);
#if (NUM_APUS >= 16)
SET_CPU_FREQ(8, 2720000);
SET_CPU_FREQ(9, 2720000);
SET_CPU_FREQ(10, 2720000);
SET_CPU_FREQ(11, 2720000);
SET_CPU_FREQ(12, 2720000);
SET_CPU_FREQ(13, 2720000);
SET_CPU_FREQ(14, 2720000);
SET_CPU_FREQ(15, 2720000);
#endif
#if (NUM_APUS >= 32)
SET_CPU_FREQ(16, 2720000);
SET_CPU_FREQ(17, 2720000);
SET_CPU_FREQ(18, 2720000);
SET_CPU_FREQ(19, 2720000);
SET_CPU_FREQ(20, 2720000);
SET_CPU_FREQ(21, 2720000);
SET_CPU_FREQ(22, 2720000);
SET_CPU_FREQ(23, 2720000);
SET_CPU_FREQ(24, 2720000);
SET_CPU_FREQ(25, 2720000);
SET_CPU_FREQ(26, 2720000);
SET_CPU_FREQ(27, 2720000);
SET_CPU_FREQ(28, 2720000);
SET_CPU_FREQ(29, 2720000);
SET_CPU_FREQ(30, 2720000);
SET_CPU_FREQ(31, 2720000);
#endif

&rpu_ctrl_a {
	cpu0 = <&rpu_cpu0>;
	cpu1 = <&rpu_cpu1>;
	tcm-mr = <&s_axi_tcm_a>;
};

&rpu_ctrl_b {
	cpu0 = <&rpu_cpu2>;
	cpu1 = <&rpu_cpu3>;
	tcm-mr = <&s_axi_tcm_b>;
};

