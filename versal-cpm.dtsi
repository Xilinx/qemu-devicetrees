/*
 * Versal PS CPM
 *
 * Copyright (C) 2026, Advanced Micro Devices, Inc.
 *
 * SPDX-License-Identifier: BSD-3-Clause
 *
 */

&amba_fpd {
	cpm_crcpm@MM_CPM_CPM_CRCPM {
		compatible = "xlnx,versal_cpm_crcpm";
		reg = <0x0 MM_CPM_CPM_CRCPM 0x0 MM_CPM_CPM_CRCPM_SIZE 0x0>;
	};

	cpm_pcsr@MM_CPM_CPM_PCSR {
		compatible = "xlnx,versal_cpm_pcsr";
		reg = <0x0 MM_CPM_CPM_PCSR 0x0 MM_CPM_CPM_PCSR_SIZE 0x0>;
	};

	cpm_slcr_secure@MM_CPM_CPM_SLCR_SECURE {
		compatible = "xlnx.cpm_slcr_secure";
		reg = <0x0 MM_CPM_CPM_SLCR_SECURE 0x0 MM_CPM_CPM_SLCR_SECURE_SIZE 0x0>;
	};
};
