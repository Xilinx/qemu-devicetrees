/*
 * Versal XCV80 virtual board dts
 *
 * Copyright (c) 2023, Advanced Micro Devices, Inc.
 * All rights reserved.
 *
 * SPDX-License-Identifier: BSD-3-Clause
 */

#include "board-versal-xcvh1782-ps-virt.dts"

&pmc_tap {
	idcode = <0x14D2F093>;
};
