/*
 * Versal AI RF series xcvr1952 virtual board device tree
 *
 * Copyright Advanced Micro Devices, Inc.
 *
 * SPDX-License-Identifier: BSD-3-Clause
 */

#include "board-versal-xcvr1902p-ps-virt.dts"

&pmc_tap {
	idcode = <0x04CB2093>;
};
