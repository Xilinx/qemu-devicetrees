/*
 * Versal Gen 2 xc2vp3202 PMC board device tree.
 *
 * Copyright Advanced Micro Devices, Inc.
 *
 * SPDX-License-Identifier: BSD-3-Clause
 */

#include "versal2/2vp/memmap/xc2vp3202.dtsh"
#include "versal2/2vp/memmap/xc2vp3202-npi.dtsh"

#include "versal-2vp-pmc.dtsi"
