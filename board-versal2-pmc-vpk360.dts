/*
 * Versal premium series Gen 2 VPK360 board PMC device tree
 *
 * Copyright Advanced Micro Devices, Inc.
 *
 * SPDX-License-Identifier: BSD-3-Clause
 */

#include "board-versal2-xc2vp3602-pmc-virt.dts"
