/*
 * Versal premium series Gen 2 VPK360 cosim device tree
 *
 * Copyright Advanced Micro Devices, Inc.
 *
 * SPDX-License-Identifier: BSD-3-Clause
 */

#include "board-versal2-ps-vpk360.dts"
#include "versal-ps-pl-remoteport.dtsi"
