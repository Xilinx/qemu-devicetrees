/*
 * Versal Prime series device xcvm1402_SE virtual board dts
 *
 * Copyright (c) 2024, Advanced Micro Devices Inc. All rights reserved.
 *
 * SPDX-License-Identifier: BSD-3-Clause
 */

#include "board-versal-xcvm1402-ps-virt.dts"

VERSAL_MARK_SE
