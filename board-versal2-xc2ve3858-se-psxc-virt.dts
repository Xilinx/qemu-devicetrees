/*
 * Versal AI Edge Series xc2ve3858-se virtual board dts
 *
 * Copyright (c) 2024, Advanced Micro Devices Inc. All rights reserved.
 *
 * SPDX-License-Identifier: BSD-3-Clause
 */

#include "board-versal2-xc2ve3858-psxc-virt.dts"

VERSAL_MARK_SE
