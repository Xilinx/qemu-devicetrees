/*
 * ZynqMP KV240  device tree
 *
 * Copyright (c) 2024, Advanced Micro Devices, Inc
 * All rights reserved.
 *
 * SPDX-License-Identifier: BSD-3-Clause
 *
 * K24 SOM + KV Carrier
 */

#include "board-zynqmp-k24-som.dts"
#include "board-zynqmp-sck-kv.dtsi"
