/* Versal Gen 2 ASU Emulation
 *
 * Copyright (c) 2023, AMD Inc
 * All rights reserved.
 *
 * SPDX-License-Identifier: BSD-3-Clause
 */

#include "versal2-asu-cpu.dtsi"
#include "versal2-asu-io.dtsi"
#include "versal2-asu-sec.dtsi"
