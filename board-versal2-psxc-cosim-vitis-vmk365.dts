/*
 * Vitis Versal Gen 2 VMK365 cosim board
 *
 * Copyright Advanced Micro Devices, Inc.
 *
 * SPDX-License-Identifier: BSD-3-Clause
 */

#include "board-versal2-psxc-vmk365.dts"
#include "versal2-pl-remoteport.dtsi"
#include "versal-vitis.dtsi"
