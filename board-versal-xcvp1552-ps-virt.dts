/*
 * Versal Premium series device xcvp1552 virtual board dts
 *
 * Copyright (c) 2023 Advanced Micro Devices, Inc.
 * All rights reserved.
 *
 * The NPI memmap is the same as for xcvh1582.
 *
 * SPDX-License-Identifier: BSD-3-Clause
 */

#define VERSAL_NPI_OVERRIDE
#define VERSAL_HAS_CPM5
#include "versal/memmap/xcvp1202.dtsh" /* same memory map as xcvp1202 */
#include "versal/memmap/versal-xcvh1582-npi-memmap.dtsi"
#include "board-versal-ps-virt.dts"
#include "versal-silicon-freq.dtsi"

&pmc_err_mng {
	ssit = <1>;
};

&pmc_tap {
	idcode = <0x14D34093>;
};
