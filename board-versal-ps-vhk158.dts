/*
 * Versal VHK158 board device tree
 * Supported Features:
 * OSPI
 * SD/EMMC
 * EEPROM
 *
 * Un-supported Features:
 * CPM
 * PCIE
 * QSFP
 * System Controller
 * I2C PM Bus
 *
 * Boot Devices Supported: OSPI & SD
 *
 * Copyright (c) 2021, Xilinx Inc
 * All rights reserved.
 *
 * SPDX-License-Identifier: BSD-3-Clause
 */

#include "board-versal-xcvh1582-ps-virt.dts"

/* QSPI is not preferred boot device */
&pmc_qspi_0 {
	/delete-node/ qspi_flash_lcs_lb@0;
	/delete-node/ qspi_flash_lcs_ub@0;
	/delete-node/ qspi_flash_ucs_lb@0;
	/delete-node/ qspi_flash_ucs_ub@0;
};

/* Attach only one OSPI Flash */
&ospi {
	/delete-node/ ospi_flash_lcs_ub@0;
	/delete-node/ ospi_flash_ucs_lb@0;
	/delete-node/ ospi_flash_ucs_ub@0;
};

&ospi_flash_lcs_lb {
	compatible = "mt35xu02gbba";
};

&ps_i2c1 {
	eeprom_versal: eeprom@51 {
		compatible = "at,24c08";
		reg = <0x54>;
		size = <0x4000>;
		blockdev-node-name = "ps_i2c1.eeprom-54";
	};
};

/{
	hbmmc_0_mem: memory@MM_TOP_HBM0 {
		compatible = "qemu:memory-region";
		device_type = "memory";
		container = <&amba>;
	};

	MEM_REGION64(hbmmc_bnk0, MM_TOP_HBM0_H, MM_TOP_HBM0_L, MM_TOP_HBM0,
                 0x8, 0x0, &hbmmc_0_mem) // 32 GB
};
