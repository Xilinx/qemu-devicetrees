/*
 * Versal vrk165 cosim board device tree
 *
 * Copyright Advanced Micro Devices, Inc.
 *
 * SPDX-License-Identifier: BSD-3-Clause
 */

#include "board-versal-ps-vrk165-revB.dts"
#include "versal-ps-pl-remoteport.dtsi"
