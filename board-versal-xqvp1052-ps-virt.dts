/*
 * Versal Premium series xqvp1052 virtual board device tree
 *
 * Copyright (c) 2024, Advanced Micro Devices, Inc
 * All rights reserved.
 *
 * SPDX-License-Identifier: BSD-3-Clause
 */

#include "board-versal-xcvp1052-ps-virt.dts"
