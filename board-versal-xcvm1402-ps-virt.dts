/*
 * Versal Prime series device xcvm1402 virtual board dts
 *
 * Copyright (c) 2023, Advanced Micro Devices Inc. All rights reserved.
 *
 * SPDX-License-Identifier: BSD-3-Clause
 */

#define VERSAL_NPI_OVERRIDE
#include "versal/memmap/versal-xcvm1402-npi-memmap.dtsi"
#include "board-versal-ps-virt.dts"
#include "versal-silicon-freq.dtsi"

&pmc_tap {
	idcode = <0x04C08093>;
};
