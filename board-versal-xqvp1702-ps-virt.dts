/*
 * Versal AI Edge series device xqvp1702 virtual board dts
 *
 * Copyright (c) 2024, Advanced Micro Devices Inc
 * All rights reserved.
 *
 * SPDX-License-Identifier: BSD-3-Clause
 */

#include "board-versal-xcvp1702-ps-virt.dts"
