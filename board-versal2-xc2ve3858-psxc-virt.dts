/*
 * Versal AI Edge Series xc2ve3858 virtual board dts
 *
 * Copyright (c) 2024, Advanced Micro Devices Inc. All rights reserved.
 *
 * SPDX-License-Identifier: BSD-3-Clause
 */
#include "board-versal2-psxc-virt.dts"

&pmc_tap {
    idcode = <0x04DB0093>;
};
