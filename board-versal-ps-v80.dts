/*
 * Versal Alveo V80.
 *
 * Copyright (c) 2024, Advanced Micro Devices Inc. All rights reserved.
 *
 * SPDX-License-Identifier: BSD-3-Clause
 */

#include "board-versal-xcv80-ps-virt.dts"

/*
 * 2GB OSPI
 * 32GB HBM
 */

/ {
	MEM_REGION64(c1_ddr, MM_TOP_DDR_CH1_H, MM_TOP_DDR_CH1_L, MM_TOP_DDR_CH1,
			0x00000004,  0x00000000, &ddr_2_mem) // 16GB
	MEM_REGION64(c2_ddr, MM_TOP_DDR_CH1_2_H, MM_TOP_DDR_CH1_2_L, MM_TOP_DDR_CH1_2,
			0x00000004,  0x00000000, &ddr_2_mem) // 16GB
};

&ospi {
	/delete-node/ ospi_flash_lcs_ub@0;
	/delete-node/ ospi_flash_ucs_lb@0;
	/delete-node/ ospi_flash_ucs_ub@0;
};

&ospi_flash_lcs_lb {
	compatible = "mt35xu02gbba";
};

&spi0_flash0 {
    /* 4 MiB */
    compatible = "m25p32";
};
