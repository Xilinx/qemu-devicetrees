/*
 * Versal Virtual xcvh1742-se board device tree
 *
 * Copyright (c) 2024, Advanced Micro Devices, Inc
 * All rights reserved.
 *
 * SPDX-License-Identifier: BSD-3-Clause
 */

#include "board-versal-xcvh1742-ps-virt.dts"

VERSAL_MARK_SE
