/*
 * Versal premium series device xc2vp3602 virtual board dts
 *
 * Copyright (C) 2025 Advanced Micro Devices, Inc. All rights reserved.
 *
 * SPDX-License-Identifier: BSD-3-Clause
 */

#include "versal2/2vp/memmap/xc2vp3602.dtsh"
#include "versal2/2vp/memmap/xc2vp3602-npi.dtsh"
#define XC2VP3602

#include "versal-2vp-pmc.dtsi"
