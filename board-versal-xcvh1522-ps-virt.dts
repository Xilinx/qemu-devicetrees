/*
 * Versal Virtual xcvh1522 board device tree
 *
 * Copyright (c) 2023 Advanced Micro Devices, Inc.
 * All rights reserved.
 *
 * SPDX-License-Identifier: BSD-3-Clause
 */

#include "board-versal-xcvh1582-ps-virt.dts"

&pmc_tap {
	idcode = <0x14D34093>;
};
