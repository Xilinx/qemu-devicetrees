/*
 * Versal Premium Gen 2 series device xc2vp3202 virtual board dts
 *
 * Copyright (c) 2024-2026, Advanced Micro Devices Inc.
 *
 * SPDX-License-Identifier: BSD-3-Clause
 */

#include "versal2/2vp/memmap/xc2vp3202.dtsh"
#include "versal2/2vp/memmap/xc2vp3202-npi.dtsh"

#include "versal-2vp-ps.dtsi"

&pmc_tap {
  idcode = <0x04C68093>;
};
