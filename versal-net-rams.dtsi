/*
 * Versal Net rams Overlay.
 *
 * Copyright (C) 2025 Advanced Micro Devices, Inc. All rights reserved.
 *
 * SPDX-License-Identifier: BSD-3-Clause
 */

#include "versal.dtsh"

/{
    ocm_mem1: ocm_mem1@MM_OCM1_MEM {
        compatible = "qemu:memory-region";
    };

    MEM_REGION(ocm_mem_bank1_0, 0x0, 0x00000, ,
                        (MM_OCM1_MEM_SIZE / 4), &ocm_mem1)
    MEM_REGION(ocm_mem_bank1_1, 0x0, (MM_OCM1_MEM_SIZE / 4), ,
                        (MM_OCM1_MEM_SIZE / 4), &ocm_mem1)
    MEM_REGION(ocm_mem_bank1_2, 0x0, ((MM_OCM1_MEM_SIZE / 4) * 2), ,
                        (MM_OCM1_MEM_SIZE / 4), &ocm_mem1)
    MEM_REGION(ocm_mem_bank1_3, 0x0, ((MM_OCM1_MEM_SIZE / 4) * 3), ,
                        (MM_OCM1_MEM_SIZE / 4), &ocm_mem1)
};

&amba {
    xmpu_ocm1: xmpu_ocm1@0 {
        compatible = "xlnx,versal-xmpu";
        interrupts = <XMPU_OCM_IRQ_0>;
        reg-extended = <
                &amba 0x0 MM_OCM1_XMPU 0x0 MM_OCM1_XMPU_SIZE 0x0
                &amba 0x0 MM_OCM1_MEM 0x0 MM_OCM1_MEM_SIZE 0x2>;
        protected-mr = <&ocm_mem1>;
        mr-0 = <&amba>;
        protected-base = <MM_OCM1_MEM>;
    };
};
