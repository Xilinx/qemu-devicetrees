/*
 * Versal Premium Gen 2 series PMC
 *
 * Copyright (c) 2026, Advanced Micro Devices Inc. All rights reserved.
 *
 * SPDX-License-Identifier: BSD-3-Clause
 */

#include "versal2/2vp/memmap/aliases.dtsh"
#include "versal-ddrmc5e-aliases.dtsh"

#define VERSAL_2VP_DEV
#define VERSAL_NPI_OVERRIDE
#define VERSAL_HAS_CPM6
#ifndef XC2VP3602
# define VERSAL_PMX
#endif

#include "board-versal-pmc-virt.dts"
#ifndef MULTI_ARCH
# include "versal-2vp-pmc-override.dtsi"
#endif
