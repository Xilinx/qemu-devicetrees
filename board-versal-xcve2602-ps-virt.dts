/*
 * Versal AI Edge series device xcve2602 virtual board dts
 *
 * Copyright (c) 2023 Advanced Micro Devices, Inc.
 * All rights reserved.
 *
 * SPDX-License-Identifier: BSD-3-Clause
 */
#include "board-versal-xcvc2802-ps-virt.dts"

&pmc_tap {
	idcode = <0x14CD2093>;
};
