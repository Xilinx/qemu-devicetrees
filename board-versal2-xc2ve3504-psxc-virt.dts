/*
 * Versal AI Edge xc2ve3504 virtual board dts
 *
 * Copyright (c) 2024, Advanced Micro Devices Inc. All rights reserved.
 *
 * SPDX-License-Identifier: BSD-3-Clause
 */

#define NUM_RPUS 4
#define NUM_APUS 4
#define VERSAL2_NPI_OVERRIDE
#include "versal2-xc2ve3558-npi-memmap.dtsi"

#include "board-versal2-psxc-virt.dts"

&pmc_tap {
    idcode = <0x04DAB093>;
};
