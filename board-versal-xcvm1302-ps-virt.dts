/*
 * Versal Prime series device xcvm1302 virtual board dts
 *
 * Copyright (c) 2023, Advanced Micro Devices Inc. All rights reserved.
 *
 * SPDX-License-Identifier: BSD-3-Clause
 */

#include "board-versal-xcvm1402-ps-virt.dts"

&pmc_tap {
	idcode = <0x04C09093>;
};
