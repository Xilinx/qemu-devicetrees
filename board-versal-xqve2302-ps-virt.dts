/*
 * Versal AI Edge series xqve2302 virtual board device tree
 *
 * Copyright (c) 2024, Advanced Micro Devices, Inc
 * All rights reserved.
 *
 * SPDX-License-Identifier: BSD-3-Clause
 */

#include "board-versal-xcve2302-ps-virt.dts"
