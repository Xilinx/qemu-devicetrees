/*
 * Versal Premium series device xcvp1502 virtual board dts
 *
 * Copyright (c) 2023, Advanced Micro Devices Inc. All rights reserved.
 *
 * SPDX-License-Identifier: BSD-3-Clause
 */

#include "board-versal-xcvp1202-ps-virt.dts"

&pmc_tap {
	idcode = <0x14D08093>;
};

&pmc_err_mng {
	ssit = <1>;
};
