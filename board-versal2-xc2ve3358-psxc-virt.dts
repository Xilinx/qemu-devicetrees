/*
 * Versal AI Edge Series xc2ve3358 virtual board dts
 *
 * Copyright (c) 2024, Advanced Micro Devices Inc.
 * All rights reserved.
 *
 * SPDX-License-Identifier: BSD-3-Clause
 */

#define VERSAL2_NPI_OVERRIDE
#include "versal2-xc2ve3358-npi-memmap.dtsi"

#include "board-versal2-psxc-virt.dts"

&pmc_tap {
    idcode = <0x04DA0093>;
};
