/*
 * Versal premium series device xc2vp3602 virtual cosim PS
 *
 * Copyright (c) 2025, Advanced Micro Devices Inc.
 * All rights reserved.
 *
 * SPDX-License-Identifier: BSD-3-Clause
 */

#include "board-versal2-xc2vp3602-ps-virt.dts"
#include "versal-ps-pl-remoteport.dtsi"
