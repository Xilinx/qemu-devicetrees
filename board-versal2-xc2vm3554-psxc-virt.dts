/*
 * Versal Prime xc2vm3554 virtual board dts
 *
 * Copyright (c) 2024, Advanced Micro Devices Inc. All rights reserved.
 *
 * SPDX-License-Identifier: BSD-3-Clause
 */

#define NUM_RPUS 4
#define NUM_APUS 4

#include "board-versal2-psxc-virt.dts"

&pmc_tap {
    idcode = <0x04DAC093>;
};
