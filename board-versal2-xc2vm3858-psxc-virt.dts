/*
 * Versal Prime xc2vm3858 virtual board dts
 *
 * Copyright (c) 2024, Advanced Micro Devices Inc. All rights reserved.
 *
 * SPDX-License-Identifier: BSD-3-Clause
 */

#define NUM_RPUS 10
#define NUM_APUS 8

#include "board-versal2-psxc-virt.dts"

&pmc_tap {
    idcode = <0x04DB2093>;
};
