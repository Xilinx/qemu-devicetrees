/*
 * Versal VMK180 board device tree
 *
 * Boot Devices Supported: QSPI & SD
 *
 * Copyright (c) 2024, Advanced Micro Devices, Inc.
 * All rights reserved.
 *
 * SPDX-License-Identifier: BSD-3-Clause
 */


#include "board-versal-xcvm1802-ps-virt.dts"

&ospi {
	/delete-node/ ospi_flash_lcs_lb;
	/delete-node/ ospi_flash_lcs_ub;
	/delete-node/ ospi_flash_ucs_lb;
	/delete-node/ ospi_flash_ucs_ub;
};

/{
	/delete-node/ ddr_2@MM_TOP_DDR_2;

	MEM_REGION64(ddr_2,MM_TOP_DDR_2_H, MM_TOP_DDR_2_L, MM_TOP_DDR_2,
		     0x1, 0x80000000, &ddr_2_mem)	// 6 GB
	MEM_REGION64(ddr_3, MM_TOP_DDR_CH1_H, MM_TOP_DDR_CH1_L, MM_TOP_DDR_CH1,
		     0x1, 0x0, &ddr_2_mem)	// 4 GB
	MEM_REGION64(ddr_4, MM_TOP_DDR_CH2_H, MM_TOP_DDR_CH2_L, MM_TOP_DDR_CH2,
		     0x1, 0x0, &ddr_2_mem)	// 4 GB

};

&mdio0 {
		/delete-node/ phy@2;
		phy1: phy@2 {
			compatible = "dp83867";
			device_type = "ethernet-phy";
			reg = <2>;
		};
};
