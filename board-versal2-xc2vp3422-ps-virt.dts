/*
 * Versal Premium Gen 2 series device XC2VP3422 MOP virtual board dts
 *
 * Copyright Advanced Micro Devices, Inc.
 *
 * SPDX-License-Identifier: BSD-3-Clause
 */

#include "board-versal2-xc2vp3402-ps-virt.dts"

/{
    hbmmc_0_mem: memory@MM_HBM0 {
        compatible = "qemu:memory-region";
        device_type = "memory";
        container = <&amba>;
    };

    MEM_REGION64(hbmmc_bnk0, MM_HBM0_H, MM_HBM0_L, MM_HBM0,
                 0x2, 0x0, &hbmmc_0_mem) // 8 GB

    hbmmc_1_mem: memory@MM_HBM1 {
        compatible = "qemu:memory-region";
        device_type = "memory";
        container = <&amba>;
    };

    MEM_REGION64(hbmmc_bnk1, MM_HBM1_H, MM_HBM1_L, MM_HBM1,
                 0x2, 0x0, &hbmmc_0_mem) // 8 GB

    hbmmc_2_mem: memory@MM_HBM2 {
        compatible = "qemu:memory-region";
        device_type = "memory";
        container = <&amba>;
    };

    MEM_REGION64(hbmmc_bnk2, MM_HBM2_H, MM_HBM2_L, MM_HBM2,
                 0x2, 0x0, &hbmmc_0_mem) // 8 GB

    hbmmc_3_mem: memory@MM_HBM3 {
        compatible = "qemu:memory-region";
        device_type = "memory";
        container = <&amba>;
    };

    MEM_REGION64(hbmmc_bnk3, MM_HBM3_H, MM_HBM3_L, MM_HBM3,
                 0x2, 0x0, &hbmmc_0_mem) // 8 GB

};
