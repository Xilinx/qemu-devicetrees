/*
 * Versal AI Core series device xcvp2502 virtual board dts
 *
 * Copyright (c) 2021, Xilinx Inc
 * All rights reserved.
 *
 * SPDX-License-Identifier: BSD-3-Clause
 */

/*
 * Unsupported Devices:
 *  CPM
 *  PCIE
 *  AIE (part of slave SLR)
 */

#define VERSAL_NPI_OVERRIDE
#include "versal/memmap/versal-xcvp2502-npi-memmap.dtsi"
#include "board-versal-ps-virt.dts"
#include "versal-silicon-freq.dtsi"

/{
	model = "Versal s100 virt";
};

&pmc_err_mng {
	ssit = <1>;
};

&pmc_tap {
	idcode= <0x14D1C093>;
};
